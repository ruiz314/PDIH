#include <LedControl.h>

const int botonPin = 7;      // Pin del pulsador
bool estadoBoton;
const int espera = 200;      // Unidad de tiempo Morse

// Pines para la Matriz LED 
const int DINpin = 12;
const int CSpin  = 11;
const int CLKpin = 10;

// Inicializar matriz con 1 dispositivo
LedControl lc = LedControl(DINpin, CLKpin, CSpin, 1);


unsigned long tiempoInicio = 0;
unsigned long duracionPulsacion = 0;
String secuenciaMorse = "";

char* letras[] = {
  ".-", "-...", "-.-.", "-..", ".", "..-.", "--.", "....", "..", ".---", 
  "-.-", ".-..", "--", "-.", "---", ".--.", "--.-", ".-.", "...", "-", 
  "..-", "...-", ".--", "-..-", "-.--", "--.."
};

char* numeros[] = {
  "-----", ".----", "..---", "...--", "....-", ".....", "-....", "--...", "---..", "----."
};

// Definición de caracteres (8 bytes por fila) para matriz
// Definición de caracteres A-Z (8 bytes por letra)
const uint8_t fuenteMorse[26][8] PROGMEM = {
  {0x18, 0x24, 0x42, 0x42, 0x7E, 0x42, 0x42, 0x42}, // A
  {0x7C, 0x22, 0x22, 0x3C, 0x22, 0x22, 0x7C, 0x00}, // B
  {0x3C, 0x42, 0x40, 0x40, 0x40, 0x42, 0x3C, 0x00}, // C
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  {0x7E, 0x02, 0x04, 0x08, 0x10, 0x20, 0x7E, 0x00}  // Z
};

const uint8_t numerosMorse[10][8] PROGMEM = {
  {0x3C, 0x46, 0x4A, 0x52, 0x62, 0x42, 0x3C, 0x00}, // 0
  {0x18, 0x28, 0x08, 0x08, 0x08, 0x08, 0x3E, 0x00}, // 1
  {0x3C, 0x42, 0x02, 0x3C, 0x40, 0x40, 0x7E, 0x00}, // 2
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  {0x3C, 0x42, 0x42, 0x3E, 0x02, 0x02, 0x3C, 0x00}  // 9
};

void setup() {
  lc.shutdown(0, false);       // Salir de modo ahorro
  lc.setIntensity(0, 8);       // Brillo (0-15)
  lc.clearDisplay(0);          // Limpiar matriz
  
  pinMode(botonPin, INPUT);
  Serial.begin(9600);
  Serial.println("Receptor Morse con Matriz 8x8 Listo...");
}

void loop() {
  estadoBoton = digitalRead(botonPin);

  // Detectar cuando se pulsa el botón
  if (estadoBoton == HIGH) {
    tiempoInicio = millis();
    while (digitalRead(botonPin) == HIGH); // Esperar a soltar
    duracionPulsacion = millis() - tiempoInicio;

    if (duracionPulsacion > 50) { // Anti-rebote
      if (duracionPulsacion < (espera * 1.5)) {
        secuenciaMorse += ".";
        Serial.print(".");
      } else {
        secuenciaMorse += "-";
        Serial.print("-");
      }
    }
    delay(50);
  }
  else 

  // Si pasa tiempo suficiente sin pulsar, traducimos
  if (secuenciaMorse.length() > 0 && (millis() - tiempoInicio > espera * 3)) {
    traducirYMostrar();
  }
}

void traducirYMostrar() {
  char letraEncontrada = ' ';
  bool encontrado = false;

  // Buscar en letras
  for (int i = 0; i < 26; i++) {
    if (secuenciaMorse == letras[i]) {
      letraEncontrada = 'A' + i;
      encontrado = true;
      break;
    }
  }

  // Buscar en números si no se encontró en letras
  if (!encontrado) {
    for (int i = 0; i < 10; i++) {
      if (secuenciaMorse == numeros[i]) {
        letraEncontrada = '0' + i;
        encontrado = true;
        break;
      }
    }
  }

  if (encontrado) {
    Serial.print(" -> ");
    Serial.println(letraEncontrada);
    mostrarEnMatriz(letraEncontrada);
  } else {
    Serial.println(" -> Error");
    lc.clearDisplay(0); // O mostrar una 'X' de error
  }
  
  secuenciaMorse = ""; // Limpiar para el siguiente caracter
}

// Función para mostrar el caracter en la matriz 8x8
void mostrarEnMatriz(char c) {
  lc.clearDisplay(0); // Limpiar matriz anterior
  if (c >= 'A' && c <= 'Z') {
    int indice = c - 'A';
    for (int i = 0; i < 8; i++) {
      // Leer el dibujo desde la memoria de programa (PROGMEM) y enviarlo a la matriz
      lc.setRow(0, i, pgm_read_byte(&(fuenteMorse[indice][i])));
    }
  }
  else if (c >= '0' && c <= '9') {
    int indice = c - '0';
    for (int i = 0; i < 8; i++) {
      lc.setRow(0, i, pgm_read_byte(&(numerosMorse[indice][i])));
    }
  }
}
